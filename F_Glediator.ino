



//############################################################################################################################################################
// USART-Interrupt-Prozedur (called every time one byte is compeltely received)                                                                               #
//############################################################################################################################################################

ISR(USART0_RX_vect) 
{
  unsigned char b;
  
  b=UDR0;
  
  if (b == CMD_NEW_DATA)  {pos=0; ptr=display_buffer; return;}    
  if (pos == (Num_Pixels*3)) {} else {*ptr=b; ptr++; pos++;}  
  if (pos == ((Num_Pixels*3)-1)) {go=1;}
}


//############################################################################################################################################################
// Shift out Data                                                                                                                                            #
//############################################################################################################################################################

void shift_out_data()
{

  for (int i=0; i<Num_Pixels; i++)
  {
    byte r = display_buffer[i*3+0];
    byte g = display_buffer[i*3+1];
    byte b = display_buffer[i*3+2];
        
    for (byte j=0; j<8; j++)
    {
       Set_CLK_Low;
       if (r & (1<<(7-j))) {Set_SDO_High;} else {Set_SDO_Low;}     
       Set_CLK_High; 
    }
    
    for (byte j=0; j<8; j++)
    {
       Set_CLK_Low;
       if (g & (1<<(7-j))) {Set_SDO_High;} else {Set_SDO_Low;}     
       Set_CLK_High;
    }
    
     for (byte j=0; j<8; j++)
    {
       Set_CLK_Low;
       if (b & (byte)(1<<(7-j))) {Set_SDO_High;} else {Set_SDO_Low;}     
       Set_CLK_High;
    }
  }
  
  Set_CLK_Low;
  delayMicroseconds(800); //Latch Data
  
}

//############################################################################################################################################################
//############################################################################################################################################################
//############################################################################################################################################################

